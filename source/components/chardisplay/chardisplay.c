#include "stm32f4xx_hal.h"
#include "chardisplay.h"
#include "stm32f4xx_hal_spi.h"
#include "timer.h"
#include <stdio.h>

static const char fontTable[];
static SPI_HandleTypeDef _spi_h; 

static inline void _CE_set(int input)
{
	HAL_GPIO_WritePin(DISPLAY_CE_PORT, DISPLAY_CE_PIN, (GPIO_PinState)input);
}
static inline void _RS_set(int input)
{
	HAL_GPIO_WritePin(DISPLAY_RS_PORT, DISPLAY_RS_PIN, (GPIO_PinState)input);
}
static inline void _RESET_set(int input)
{
	HAL_GPIO_WritePin(DISPLAY_RESET_PORT, DISPLAY_RESET_PIN, (GPIO_PinState)input);
}

/****************************************************************/
/*                    display four characters                   */
/*                this can be called during 1ms ISR             */
/****************************************************************/
void display_init(void)
{
	// Clock enables.
	__SPI1_CLK_ENABLE();
	__GPIOA_CLK_ENABLE();
	__GPIOC_CLK_ENABLE();
	// Init GPIOs
	// MOSI and SCK pins
	GPIO_InitTypeDef gpio_setting = {
		.Pin = DISPLAY_MOSI_PIN | DISPLAY_SCK_PIN,
		.Mode = GPIO_MODE_AF_PP,
		.Pull = GPIO_NOPULL,
		.Speed = GPIO_SPEED_FREQ_VERY_HIGH // 50MHz
	};
	HAL_GPIO_Init(DISPLAY_MOSI_PORT, &gpio_setting);
	//  CE PIN
	gpio_setting = (GPIO_InitTypeDef){
		.Pin = DISPLAY_CE_PIN,
		.Mode = GPIO_MODE_OUTPUT_PP,
		.Pull = GPIO_NOPULL,
		.Speed = GPIO_SPEED_FREQ_VERY_HIGH // 50MHz
	};
	HAL_GPIO_Init(DISPLAY_CE_PORT, &gpio_setting);
	// RS and RESET pins
	gpio_setting = (GPIO_InitTypeDef){
		.Pin = DISPLAY_RS_PIN | DISPLAY_RESET_PIN,
		.Mode = GPIO_MODE_OUTPUT_PP,
		.Pull = GPIO_NOPULL,
		.Speed = GPIO_SPEED_FREQ_VERY_HIGH // 50MHz
	};
	HAL_GPIO_Init(DISPLAY_RS_PORT, &gpio_setting);

	// then init SPI.
	/*
	 * Clock Signal. SPI1 is located in APB2. It runs at 22.5 MHz
	 * So the clock divided into 4. : 22.5/4 MHz
	 * HCMS-290x requirements:
	 * Fclk = 5MHz at Vlogic = 5V, 4MHz at Vlogic = 3V.
	 * Our project uses 5V for Vlogic.
	 */
	_spi_h = (SPI_HandleTypeDef){
		.Instance = SPI1,
		.Init.Mode = SPI_MODE_MASTER,
		.Init.Direction = SPI_DIRECTION_1LINE, // We only send 1 TX line
		.Init.DataSize = SPI_DATASIZE_8BIT,
		.Init.CLKPolarity = SPI_POLARITY_HIGH,
		.Init.CLKPhase = SPI_PHASE_1EDGE,
		.Init.NSS = SPI_NSS_SOFT,			// No hardware NSS pin
		.Init.BaudRatePrescaler = SPI_BAUDRATEPRESCALER_8,
		.Init.FirstBit = SPI_FIRSTBIT_MSB,
		.Init.TIMode = SPI_TIMODE_DISABLED,
		.Init.CRCCalculation = SPI_CRCCALCULATION_DISABLED,
		.Init.CRCPolynomial = 100
	};
	HAL_SPI_Init(&_spi_h);

	// set pins
	_RESET_set(1);
	_RS_set(1);
	_CE_set(1);
}

void display_matrix(const char *s)
{
	int i, j;
	char const *ptr; //pointer for starting address of character s
	_RS_set(0);	//select control register
	_CE_set(0);	//enable data writing

	for(i=0; i<4; i++)
	{
		ptr = &fontTable[s[i]*5];
		for(j=0; j<5; j++)
		{	// Fix it to just write 5 bytes
			while (HAL_SPI_STATE_BUSY_TX == HAL_SPI_GetState(&_spi_h))
			{
				// wait until the SPI being finished
			}
			HAL_SPI_Transmit(&_spi_h, *ptr, 1, 0);
			ptr++;
		}//for j
	}//for i
	while (HAL_SPI_STATE_BUSY_TX == HAL_SPI_GetState(&_spi_h))
	{
		// wait until the SPI being finished
	}
	while (HAL_SPI_STATE_BUSY == HAL_SPI_GetState(&_spi_h))
	{
		// wait until the SPI being finished
	}
	_CE_set(1);   //latch on
}

void display_err(int err) {
	char str[5];
	snprintf(str, 5, "E%03d", err);

	display_matrix(str);
}

void display_float(float f) {
	//a string with the format xx.x
	char str[5]; //need 5 because of null byte

	snprintf(str, 5, "%.1f", f);

	display_matrix(str);
}

void display_int(int i) {
	char str[5];

	snprintf(str, 5, "%04d", i);

	display_matrix(str);
}

void display_matrix_scroll(char* str) {
	int i;

	for(i = 0; i < 3; i++) {
		if(str[i] == '\0') {
			display_matrix(str);
			return;
		}
	}

	i = 0;
	while(str[i+3] != '\0') {
		display_matrix(&str[i]);
		delay_ms(1000);
		i++;
	}
}


/****************************************************************/
/*                       clear screen                           */
/*                 write 4 spaces into screen                   */
/****************************************************************/
void display_clear(void)
{
	int i;
	uint8_t dummy = 0x00;
	_RS_set(0);   //select control register
	_CE_set(0);	//enable data writing
	for(i=0; i<20; i++)
	{
		while (HAL_SPI_STATE_BUSY_TX == HAL_SPI_GetState(&_spi_h))
		{
			// wait until the SPI being finished
		}
		HAL_SPI_Transmit(&_spi_h, &dummy, 1, 0);
	}
	while (HAL_SPI_STATE_BUSY_TX == HAL_SPI_GetState(&_spi_h))
	{
		// wait until the SPI being finished
	}
	while (HAL_SPI_STATE_BUSY == HAL_SPI_GetState(&_spi_h))
	{
		// wait until the SPI being finished
	}
	_CE_set(1);   //latch on
}



static const char fontTable[] = {
	//0
	0x80, 0x80, 0x80, 0x80, 0x80, // (space)
	0x40, 0x40, 0x40, 0x40, 0x40, // (space)
	0x20, 0x20, 0x20, 0x20, 0x20, // (space)
	0x10, 0x10, 0x10, 0x10, 0x10, // (space)
	0x08, 0x08, 0x08, 0x08, 0x08, // (space)
	0x04, 0x04, 0x04, 0x04, 0x04, // (space)
	0x02, 0x02, 0x02, 0x02, 0x02, // (space)
	0x01, 0x01, 0x01, 0x01, 0x01, // (space)
	//8
	0x80, 0x80, 0x80, 0x80, 0x80, // (space)
	0xc0, 0xc0, 0xc0, 0xc0, 0xc0, // (space)
	0xe0, 0xe0, 0xe0, 0xe0, 0xe0, // (space)
	0xf0, 0xf0, 0xf0, 0xf0, 0xf0, // (space)
	0xf8, 0xf8, 0xf8, 0xf8, 0xf8, // (space)
	0xfc, 0xfc, 0xfc, 0xfc, 0xfc, // (space)
	0xfe, 0xfe, 0xfe, 0xfe, 0xfe, // (space)
	0xff, 0xff, 0xff, 0xff, 0xff, // (space)
	//16
	0x7f, 0x7f, 0x7f, 0x7f, 0x7f, // (space)
	0x3f, 0x3f, 0x3f, 0x3f, 0x3f, // (space)
	0x1f, 0x1f, 0x1f, 0x1f, 0x1f, // (space)
	0x0f, 0x0f, 0x0f, 0x0f, 0x0f, // (space)
	0x07, 0x07, 0x07, 0x07, 0x07, // (space)
	0x03, 0x03, 0x03, 0x03, 0x03, // (space)
	0x01, 0x01, 0x01, 0x01, 0x01, // (space)
	0x00, 0x00, 0x00, 0x00, 0x00, // (space)

	//24
	0x7E, 0x42, 0x43, 0x42, 0x7E,
	0x7E, 0x62, 0x63, 0x62, 0x7E,
	0x7E, 0x72, 0x73, 0x72, 0x7E,
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	0x7C, 0x42, 0x72, 0x72, 0x7C,
	//32
	0x00, 0x00, 0x00, 0x00, 0x00, // space
	0x00, 0x00, 0x2f, 0x00, 0x00, // !
	0x00, 0x07, 0x00, 0x07, 0x00, // "
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	0x02, 0x01, 0x51, 0x09, 0x06, // ?
	//64
	0x32, 0x49, 0x59, 0x51, 0x3E, // @
	0x7E, 0x11, 0x11, 0x11, 0x7E, // A
	0x7F, 0x49, 0x49, 0x49, 0x36, // B
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	0x40, 0x40, 0x40, 0x40, 0x40, // _
	//96
	0x00, 0x01, 0x02, 0x04, 0x00, // '
	0x20, 0x54, 0x54, 0x54, 0x78, // a
	0x7F, 0x48, 0x44, 0x44, 0x38, // b
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	0x00, 0x41, 0x36, 0x08, 0x00, // }
	//126
	0x08, 0x08, 0x2A, 0x1C, 0x08, // ->   //~
	0x08, 0x1C, 0x2A, 0x08, 0x08, // <-   //DEL
	//128 custmized
	0x44, 0x34, 0x0F, 0x34 ,0x44, //��
	0x2C, 0x40, 0x7F, 0x00 ,0x0C, //С
	0x40, 0x30, 0x0F, 0x30 ,0x40, //��
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	0x7F, 0x7F, 0x7F, 0x7F ,0x7F, //full filled block

};

